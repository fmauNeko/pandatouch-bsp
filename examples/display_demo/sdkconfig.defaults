## examples/display_demo/sdkconfig.defaults
```kconfig
CONFIG_ESP_DEFAULT_CPU_FREQ_MHZ_240=y
CONFIG_SPIRAM=y
CONFIG_SPIRAM_MODE_OCT=y
CONFIG_SPIRAM_SPEED_80M=y
CONFIG_ESPTOOLPY_FLASHSIZE_16MB=y
CONFIG_ESPTOOLPY_FLASHMODE_QIO=y
CONFIG_ESP32S3_DATA_CACHE_64KB=y
CONFIG_ESP32S3_DATA_CACHE_LINE_64B=y

CONFIG_ESP_TASK_WDT_TIMEOUT_S=10

CONFIG_LV_CONF_SKIP=y
CONFIG_LV_FONT_MONTSERRAT_16=y
CONFIG_LV_FONT_MONTSERRAT_18=y
CONFIG_LV_FONT_MONTSERRAT_48=y
```

## examples/display_lvgl_benchmark/sdkconfig.defaults
```kconfig
# Inherit BSP defaults
CONFIG_ESP_DEFAULT_CPU_FREQ_MHZ_240=y
CONFIG_SPIRAM=y
CONFIG_SPIRAM_MODE_OCT=y
CONFIG_SPIRAM_SPEED_80M=y
CONFIG_ESPTOOLPY_FLASHSIZE_16MB=y
CONFIG_ESPTOOLPY_FLASHMODE_QIO=y
CONFIG_ESP32S3_DATA_CACHE_64KB=y
CONFIG_ESP32S3_DATA_CACHE_LINE_64B=y

# LVGL: use Kconfig values, no lv_conf.h needed
CONFIG_LV_CONF_SKIP=y

# LVGL benchmark + performance monitoring
CONFIG_LV_USE_DEMO_BENCHMARK=y
CONFIG_LV_USE_PERF_MONITOR=y
CONFIG_LV_USE_SYSMON=y

# Enable LVGL logging so benchmark summary is printed to serial via printf
# LV_LOG() in lv_demo_benchmark.c is a no-op when LV_USE_LOG=0
CONFIG_LV_USE_LOG=y
CONFIG_LV_LOG_PRINTF=y

# Silence lv_demo_benchmark.c #warning (fires when LV_MEM_SIZE < 128 kB)
# Kconfig unit is kB; LV_MEM_SIZE in C is computed as LV_MEM_SIZE_KILOBYTES * 1024
CONFIG_LV_MEM_SIZE_KILOBYTES=128

# FreeRTOS tick rate for accurate timing measurements
CONFIG_FREERTOS_HZ=1000
```

## examples/display_slint/sdkconfig.defaults
```kconfig
# CPU
CONFIG_ESP_DEFAULT_CPU_FREQ_MHZ_240=y

# PSRAM — 8 MB Octal
CONFIG_SPIRAM=y
CONFIG_SPIRAM_MODE_OCT=y
CONFIG_SPIRAM_SPEED_80M=y
CONFIG_SPIRAM_FETCH_INSTRUCTIONS=y
CONFIG_SPIRAM_RODATA=y

# Flash — 16 MB QIO
CONFIG_ESPTOOLPY_FLASHSIZE_16MB=y
CONFIG_ESPTOOLPY_FLASHMODE_QIO=y

# Cache — required for RGB LCD DMA
CONFIG_ESP32S3_DATA_CACHE_64KB=y
CONFIG_ESP32S3_DATA_CACHE_LINE_64B=y
CONFIG_ESP32S3_INSTRUCTION_CACHE_32KB=y

# FreeRTOS — Slint needs 1ms tick
CONFIG_FREERTOS_HZ=1000
# Slint's SoftwareRenderer + TabWidget require ~100KB+ stack on the main task.
# Smaller values (8KB, 32KB) cause stack overflow in render_buffer_impl.
# 150KB matches the proven ptouch-ng configuration for this hardware.
CONFIG_ESP_MAIN_TASK_STACK_SIZE=150000

# Compiler optimization
CONFIG_COMPILER_OPTIMIZATION_PERF=y
```

## pandatouch/Kconfig
```kconfig
menu "Board Support Package (Panda Touch)"

    config BSP_ERROR_CHECK
        bool "Enable error check in BSP"
        default y
        help
            Error check assert the application before returning the error code.

    menu "I2C"
        config BSP_I2C_NUM
            int "I2C peripheral index"
            default 0
            range 0 1
            help
                ESP32S3 has two I2C peripherals, pick the one you want to use.

        config BSP_I2C_FAST_MODE
            bool "Enable I2C fast mode"
            default y
            help
                I2C has two speed modes: normal (100kHz) and fast (400kHz).

        config BSP_I2C_CLK_SPEED_HZ
            int
            default 400000 if BSP_I2C_FAST_MODE
            default 100000
    endmenu

    menu "Display"
        config BSP_DISPLAY_BRIGHTNESS_LEDC_CH
            int "LEDC channel index for backlight"
            default 1
            range 0 7
            help
                LEDC channel is used to generate PWM signal that controls display brightness.

        config BSP_LCD_DRAW_BUF_HEIGHT
            int "LCD framebuf height in lines"
            default 80
            range 10 480
            help
                Framebuf is used for LVGL rendering output.

        config BSP_LCD_DRAW_BUF_DOUBLE
            bool "LCD double framebuf"
            default n
            help
                Whether to enable double framebuf for LVGL rendering.

        config BSP_LCD_RGB_BOUNCE_BUF_HEIGHT
            int "RGB bounce buffer height in lines"
            default 10
            range 2 100
            help
                Number of scanlines in the internal DRAM bounce buffer used by the
                RGB panel DMA. The DMA reads from PSRAM into this small SRAM ring
                and feeds the LCD pixel clock directly, decoupling PSRAM latency
                from pixel timing. Larger values reduce interrupt frequency at the
                cost of more internal SRAM. 10 lines (16 KB for 800-wide RGB565)
                is a good default.
    endmenu

endmenu
```

## pandatouch/sdkconfig.defaults
```kconfig
# CPU
CONFIG_ESP_DEFAULT_CPU_FREQ_MHZ_240=y

# PSRAM — 8 MB Octal
CONFIG_SPIRAM=y
CONFIG_SPIRAM_MODE_OCT=y
CONFIG_SPIRAM_SPEED_80M=y

# Flash — 16 MB QIO
CONFIG_ESPTOOLPY_FLASHSIZE_16MB=y
CONFIG_ESPTOOLPY_FLASHMODE_QIO=y

# RGB LCD needs wide data cache
CONFIG_ESP32S3_DATA_CACHE_64KB=y
CONFIG_ESP32S3_DATA_CACHE_LINE_64B=y
```
